## sdkconfig.defaults
```kconfig
CONFIG_DEVICE_ENDPOINT_NAME="Test_Ogu_ESP32"
CONFIG_SERVER_URI="coap://datagram-no-sec-ingress.alaska.ioterop.com"
#CONFIG_SERVER_URI="coap://iowa-server.ioterop.com"

CONFIG_SERVER_SHORT_ID=1234
CONFIG_SERVER_LIFETIME=60

CONFIG_ESP_WIFI_SSID="YourSSID"
CONFIG_ESP_WIFI_PASSWORD="YourPassword"

CONFIG_IOWA_LOG_LEVEL_TRACE=n
CONFIG_TEMP_SENSOR_ENABLE_DEBUG_LOG=y
CONFIG_TEMP_SENSOR_ISR_IRAM_SAFE=y
```
